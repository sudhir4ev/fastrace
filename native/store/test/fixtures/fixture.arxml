AUTOSAR XML (schema 4.0)
package /Fixture
  ecu instance Gateway
  can cluster PowertrainCan
    can physical channel PowertrainCanChannel
      frame EngineFrame: id 0x100, frame-length=8, can-addressing-mode=STANDARD
        pdu EnginePdu: length=8
          signal EngineRpm: start 0, 16 bit, little-endian, system signal EngineRpmSignal, compu {phys=raw*0.25}
  ethernet cluster BackboneEthernet
    ethernet physical channel BackboneChannel
      pdu triggering E1Pdu: pdu=E1Pdu
  pdu E1Pdu: length=12
